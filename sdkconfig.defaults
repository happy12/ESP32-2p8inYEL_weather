## sdkconfig.defaults
```kconfig
# Reduce TLS record buffer sizes to limit heap usage per TLS session.
# Default in-buffer is 16 KB; reducing to 4 KB saves ~12 KB per active
# connection and leaves more contiguous heap for subsequent handshakes.
CONFIG_MBEDTLS_ASYMMETRIC_CONTENT_LEN=y
CONFIG_MBEDTLS_SSL_IN_CONTENT_LEN=4096
CONFIG_MBEDTLS_SSL_OUT_CONTENT_LEN=1024
```
